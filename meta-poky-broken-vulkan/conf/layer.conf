## meta-poky-broken-vulkan/conf/layer.conf
```bitbake
# We have a conf and classes directory, add to BBPATH
BBPATH .= ":${LAYERDIR}"

# We DONOT have recipes-* directories
# However.. this will generate:
# WARNING: No bb files in default matched BBFILE_PATTERN_meta-poky-broken-vulkan '^/work/build/../meta-poky-broken-vulkan/meta-poky-broken-vulkan/'
# Currently, I am not sure of a good solution except the following:
# * Convince Upstream yocto to pick this up
# * Make my own distro
#
# I think the first is the option, but i'd rather want this stupid variable
# to go away.
#
BBFILES += ""

BBFILE_COLLECTIONS += "meta-poky-broken-vulkan"
BBFILE_PATTERN_meta-poky-broken-vulkan = "^${LAYERDIR}/"
BBFILE_PRIORITY_meta-poky-broken-vulkan = "6"


LAYERDEPENDS_meta-poky-broken-vulkan = "core"
LAYERSERIES_COMPAT_meta-poky-broken-vulkan = "master wrynose whinlatter styhead"

# Apply PVR broken Vulkan workaround to all images
INHERIT += "force-broken-pvr-vulkan"
```

## meta-powervr-broken-vulkan/conf/layer.conf
```bitbake
# We have a conf and classes directory, add to BBPATH
BBPATH .= ":${LAYERDIR}"

# We DONOT have recipes-* directories
# However.. this will generate:
# WARNING: No bb files in default matched BBFILE_PATTERN_meta-powervr-broken-vulkan '^/work/build/../meta-powervr-broken-vulkan/meta-powervr-broken-vulkan/'
# Currently, I am not sure of a good solution except the following:
# * Convince Upstream yocto to pick this up
# * Make my own distro
#
# I think the first is the option, but i'd rather want this stupid variable
# to go away.
#
BBFILES += ""

BBFILE_COLLECTIONS += "meta-powervr-broken-vulkan"
BBFILE_PATTERN_meta-powervr-broken-vulkan = "^${LAYERDIR}/"
BBFILE_PRIORITY_meta-powervr-broken-vulkan = "6"


LAYERDEPENDS_meta-powervr-broken-vulkan = "core"
LAYERSERIES_COMPAT_meta-powervr-broken-vulkan = "master wrynose whinlatter styhead"

# Apply PVR broken Vulkan workaround to all images
INHERIT += "force-broken-pvr-vulkan"
```
